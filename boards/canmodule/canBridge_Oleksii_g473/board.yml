## boards/canmodule/canBridge_Oleksii_g473/board.yml
```yaml
board:
  name: canBridge_Oleksii_g473
  full_name: USB CANFD TRIO (can-module.com)
  vendor: st
  socs:
    - name: stm32g473xx
```

## boards/canmodule/canbridge_g473_can_module/board.yml
```yaml
board:
  name: canbridge_g473_can_module
  vendor: canmodule
  full_name: CANBRIDGE
  socs:
    - name: stm32g473xx
```

## boards/canmodule/usbcan_iso/board.yml
```yaml
board:
  name: usbcan_iso
  full_name: USBCAN_ISO
  vendor: canmodule
  socs:
    - name: stm32f072xb
```

## boards/canmodule/usbcanfd_Oleksii_g431/board.yml
```yaml
board:
  name: usbcanfd_Oleksii_g431
  full_name: USB CANFD SOLO (can-module.com)
  vendor: st
  socs:
    - name: stm32g431xx
```

## boards/canmodule/usbcanfd_Oleksii_g473/board.yml
```yaml
board:
  name: usbcanfd_Oleksii_g473
  full_name: USB CANFD DUAL (can-module.com)
  vendor: st
  socs:
    - name: stm32g473xx
```

## boards/canmodule/usbcanfd_dual_can_module/board.yml
```yaml
board:
  name: usbcanfd_dual_can_module
  full_name: USB CANFD DUAL
  vendor: canmodule
  socs:
    - name: stm32g473xx
```
